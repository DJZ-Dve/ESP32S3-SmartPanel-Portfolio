## sdkconfig.defaults
```kconfig
CONFIG_IDF_TARGET="esp32s3"
CONFIG_IDF_TARGET_ESP32S3=y

CONFIG_PARTITION_TABLE_CUSTOM=y
CONFIG_PARTITION_TABLE_CUSTOM_FILENAME="partitions_8mb_espsr.csv"
CONFIG_PARTITION_TABLE_FILENAME="partitions_8mb_espsr.csv"
CONFIG_PARTITION_TABLE_OFFSET=0x8000
CONFIG_PARTITION_TABLE_MD5=y

CONFIG_ESPTOOLPY_FLASHMODE_QIO=y
CONFIG_ESPTOOLPY_FLASHFREQ_80M=y
CONFIG_ESPTOOLPY_FLASHFREQ="80m"
CONFIG_ESPTOOLPY_FLASHSIZE_8MB=y
CONFIG_ESPTOOLPY_FLASHSIZE="8MB"

# External 8MB Quad SPI PSRAM on the ESP32-S3 F8N8 module.
CONFIG_SPIRAM=y
CONFIG_SPIRAM_MODE_QUAD=y
CONFIG_SPIRAM_TYPE_AUTO=y
CONFIG_SPIRAM_SPEED_80M=y
CONFIG_SPIRAM_SPEED=80
CONFIG_SPIRAM_BOOT_INIT=y
CONFIG_SPIRAM_USE_MALLOC=y
CONFIG_SPIRAM_MALLOC_ALWAYSINTERNAL=4096
CONFIG_SPIRAM_TRY_ALLOCATE_WIFI_LWIP=y
CONFIG_SPIRAM_MALLOC_RESERVE_INTERNAL=32768

CONFIG_FREERTOS_HZ=1000
CONFIG_ESP_MAIN_TASK_STACK_SIZE=4096
CONFIG_ESP_IPC_TASK_STACK_SIZE=2048

# Pure ESP-IDF PPPoS path for the LE270-EU 4G modem.
CONFIG_LWIP_PPP_SUPPORT=y
CONFIG_LWIP_PPP_NOTIFY_PHASE_SUPPORT=y
CONFIG_LWIP_PPP_ENABLE_IPV6=n
CONFIG_LWIP_PPP_VJ_HEADER_COMPRESSION=n
CONFIG_LWIP_ENABLE_LCP_ECHO=y
CONFIG_LWIP_LCP_ECHOINTERVAL=10
CONFIG_LWIP_LCP_MAXECHOFAILS=3

CONFIG_ESP_CONSOLE_USB_SERIAL_JTAG=y
CONFIG_ESP_CONSOLE_USB_SERIAL_JTAG_ENABLED=y
CONFIG_ESP_CONSOLE_UART_BAUDRATE=921600

CONFIG_LOG_DEFAULT_LEVEL_INFO=y
CONFIG_LOG_DEFAULT_LEVEL=3

# 启用 OTA 应用回滚:新分区进入 PENDING_VERIFY 状态,必须在
# kHealthConfirmTimeoutMs (App_IdfOta.cpp) 内由 confirmRunningApp() 标 valid,
# 否则 bootloader 在下次启动时 fallback 到上一个分区。配合物理 reset 按钮和
# watchdog 实现 OTA 失败自救。
CONFIG_BOOTLOADER_APP_ROLLBACK_ENABLE=y

# BLE aircon migration uses ESP-IDF NimBLE in central/observer roles only.
CONFIG_BT_ENABLED=y
CONFIG_BT_BLUEDROID_ENABLED=n
CONFIG_BT_NIMBLE_ENABLED=y
CONFIG_BT_NIMBLE_MAX_CONNECTIONS=1
CONFIG_BT_NIMBLE_ROLE_CENTRAL=y
CONFIG_BT_NIMBLE_ROLE_OBSERVER=y
CONFIG_BT_NIMBLE_ROLE_PERIPHERAL=n
CONFIG_BT_NIMBLE_ROLE_BROADCASTER=n
CONFIG_BT_NIMBLE_SECURITY_ENABLE=n
CONFIG_BT_NIMBLE_NVS_PERSIST=n

# NimBLE host 改走 PSRAM,把内部 SRAM 让给 BT controller(HCI/DMA 必须内部 SRAM)。
# 之前 INTERNAL 模式下 controller 在内部 SRAM 不够时 hci_inits_failed,根因。
CONFIG_BT_NIMBLE_MEM_ALLOC_MODE_INTERNAL=n
CONFIG_BT_NIMBLE_MEM_ALLOC_MODE_DEFAULT=n
CONFIG_BT_NIMBLE_MEM_ALLOC_MODE_EXTERNAL=y
```
